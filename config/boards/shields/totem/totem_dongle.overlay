#include <dt-bindings/zmk/matrix_transform.h>
#include "totem.dtsi"

/ {
    chosen {
        zmk,matrix-transform = &default_transform;
        zmk,physical-layout = &default_layout;
        zmk,kscan = &mock_kscan;
    };

    mock_kscan: mock_kscan {
        compatible = "zmk,kscan-mock";
        columns = <0>;
        rows = <0>;
        events = <0>;
    };
};
